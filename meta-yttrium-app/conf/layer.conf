## meta-yttrium-app/conf/layer.conf
```bitbake
# We have a conf and classes directory, add to BBPATH
BBPATH .= ":${LAYERDIR}"

# We have recipes-* directories, add to BBFILES
BBFILES += "${LAYERDIR}/recipes-*/*/*.bb \
            ${LAYERDIR}/recipes-*/*/*.bbappend"

BBFILE_COLLECTIONS += "meta-yttrium-app"
BBFILE_PATTERN_meta-yttrium-app = "^${LAYERDIR}/"
BBFILE_PRIORITY_meta-yttrium-app = "6"

LAYERDEPENDS_meta-yttrium-app = "core"
LAYERSERIES_COMPAT_meta-yttrium-app = "kirkstone"
```

## meta-yttrium-bsp/conf/layer.conf
```bitbake
# We have a conf and classes directory, add to BBPATH
BBPATH .= ":${LAYERDIR}"

# We have recipes-* directories, add to BBFILES
BBFILES += "${LAYERDIR}/recipes-*/*/*.bb \
            ${LAYERDIR}/recipes-*/*/*.bbappend"

BBFILE_COLLECTIONS += "meta-yttrium-bsp"
BBFILE_PATTERN_meta-yttrium-bsp = "^${LAYERDIR}/"
BBFILE_PRIORITY_meta-yttrium-bsp = "6"

LAYERDEPENDS_meta-yttrium-bsp = "core"
LAYERSERIES_COMPAT_meta-yttrium-bsp = "kirkstone"
```

## meta-yttrium-bsp/conf/machine/yttriumpi.conf
```bitbake
MACHINEOVERRIDES =. "raspberrypi4:"

require conf/machine/raspberrypi4.conf

RPI_USE_U_BOOT = "1"
MENDER_BOOT_PART_SIZE_MB = "64"
IMAGE_INSTALL:append = " kernel-image kernel-devicetree"
IMAGE_FSTYPES:remove = " rpi-sdimg"

MENDER_FEATURES_ENABLE:append = " mender-uboot mender-image-sd"
MENDER_FEATURES_DISABLE:append = " mender-grub mender-image-uefi"

ENABLE_UART = "1"

YLED1 = "17"
YLED2 = "22"
YLED3 = "27"
```

## meta-yttrium-distro/conf/distro/yttrium.conf
```bitbake
DISTROOVERRIDES =. "poky:"

require conf/distro/poky.conf

DISTRO = "yttrium"
DISTRO_NAME = "Yttrium (Yocto Project Summit Demonstration Distro)"
DISTRO_VERSION = "1.0"
DISTRO_CODENAME = "jesting"

INHERIT += "mender-full"

INIT_MANAGER = "systemd"
```

## meta-yttrium-distro/conf/layer.conf
```bitbake
# We have a conf and classes directory, add to BBPATH
BBPATH .= ":${LAYERDIR}"

# We have recipes-* directories, add to BBFILES
BBFILES += "${LAYERDIR}/recipes-*/*/*.bb \
            ${LAYERDIR}/recipes-*/*/*.bbappend"

BBFILE_COLLECTIONS += "meta-yttrium-distro"
BBFILE_PATTERN_meta-yttrium-distro = "^${LAYERDIR}/"
BBFILE_PRIORITY_meta-yttrium-distro = "6"

LAYERDEPENDS_meta-yttrium-distro = "core"
LAYERSERIES_COMPAT_meta-yttrium-distro = "kirkstone"
```
